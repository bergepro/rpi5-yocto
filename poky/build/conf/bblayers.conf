## poky/build/conf/bblayers.conf
```bitbake
# POKY_BBLAYERS_CONF_VERSION is increased each time build/conf/bblayers.conf
# changes incompatibly
POKY_BBLAYERS_CONF_VERSION = "2"

BBPATH = "${TOPDIR}"
BBFILES ?= ""

BBLAYERS ?= " \
  /home/berge2204/rpi5-yocto/poky/meta \
  /home/berge2204/rpi5-yocto/poky/meta-poky \
  /home/berge2204/rpi5-yocto/poky/meta-yocto-bsp \
  "
```
